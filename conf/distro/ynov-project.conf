## conf/distro/ynov-project.conf
```bitbake
require conf/distro/poky.conf

# Define name of the distribution
DISTRO = "ynov-project"
DISTRO_NAME = "Ynov Project powered by Yocto/OE"

# Define systemd init manager
VIRTUAL-RUNTIME_init_manager = "systemd"
DISTRO_FEATURES_BACKFILL_CONSIDERED = "sysvinit"
VIRTUAL-RUNTIME_initscripts = ""
DISTRO_FEATURES_append = " systemd"

#INHERIT += "rm_work"

# Warp7 settings
KERNEL_MODULE_AUTOLOAD_append = " g_ether"

IMAGE_BOOT_FILES_append = " boot.scr"
```
